## boards/shields/Kconfig.defconfig
```kconfig
# Copyright (c) 2021 The ZMK Contributors
# SPDX-License-Identifier: MIT

if SHIELD_ANGRA_LEFT

config ZMK_KEYBOARD_NAME
    default "angra"

config ZMK_SPLIT_ROLE_CENTRAL
    default y

endif

if SHIELD_ANGRA_LEFT || SHIELD_ANGRA_RIGHT

config ZMK_SPLIT
    default y

endif
```

## config/boards/shields/angra/Kconfig.shield
```kconfig
# Copyright (c) 2021 The ZMK Contributors
# SPDX-License-Identifier: MIT

config SHIELD_ANGRA_LEFT
    def_bool $(shields_list_contains,angra_left)

config SHIELD_ANGRA_RIGHT
    def_bool $(shields_list_contains,angra_right)
```
